/** Arduino, Esp32 ***************************************** AttachSNTP.cpp ***
 * 
 *         Подключится к пулу серверов точного времени и синхронизировать время 
 *                                                контроллера по протоколу SNTP
 * 
 * v1.0.1, 28.12.2024                                 Автор:      Труфанов В.Е.
 * Copyright © 2024 tve                               Дата создания: 27.12.2024
**/

#include "Arduino.h"
#include "AttachSNTP.h"

// ****************************************************************************
// *                  Построить объект (конструктор класса)                   *
// ****************************************************************************
TAttachSNTP::TAttachSNTP(const char *server)
{
   ServerName=server;
}
// ****************************************************************************
// *                 Построить объект синхронизации времени                   *
// ****************************************************************************
void TAttachSNTP::Create(int smin, const char *zone)
{
   SynchroMIN=smin;
   Timezone=zone;
   // Выбираем время с начала эпохи
   time(&now);
   // Переносим время в структуру времени
   localtime_r(&now, &timeinfo);

   printf("Прошло лет с 'начала эпохи = 1900 года': %d\n", timeinfo.tm_year);

   // Если правильное время ещё не установлено, то настраиваем интервал синхронизации, 
   // имя сервера, режим работы, часовой пояс и получаем время с сервера SNTP 
   if (timeinfo.tm_year < (2023 - 1900)) 
   {
      Serial.println("Время еще не установлено. Подключаемся к Wi-Fi и получаем время по протоколу SNTP");
      initSNTP();
      wait4SNTP();
      time(&now);
   }
   // Настраиваем часовой пояс            
   setTimezone();
};
// ****************************************************************************
// *                  Отметить момент синхронизации времени                   *
// ****************************************************************************
void Synchron(struct timeval* t) 
{
   Serial.println("Синхронизировано!");
}
// ****************************************************************************
// * Настроить интервал синхронизации, имя сервера, режим работы и часовой пояс
// ****************************************************************************
void TAttachSNTP::initSNTP() 
{ 
   // Определяем синхронизирацию внутренних часов ESP32 с сервером 
   // SNTP через интервал в один час.
   sntp_set_sync_interval(1 * SynchroMIN * 60 * 1000UL);  
   // Указываем функцию уведомления (callback) при каждой синхронизации. 
   sntp_set_time_sync_notification_cb(Synchron);
   // Устанавливаем режим работы: ESP_SNTP_OPMODE_POLL — просто опрашивать
   esp_sntp_setoperatingmode(ESP_SNTP_OPMODE_POLL);
   // Указываем пул NTP-серверов 
   esp_sntp_setservername(0, ServerName);
   // Запускаем службу SNTP с указанными выше параметрами
   esp_sntp_init();
   // Устанавливаем часовой пояс
   setTimezone();
}
// ****************************************************************************
// *                           Настроить часовой пояс                         *
// ****************************************************************************
void TAttachSNTP::setTimezone() 
{ 
   setenv("TZ", Timezone, 1);
   tzset();
}
// ****************************************************************************
// *                            Ожидать синхронизацию                         *
// ****************************************************************************
void TAttachSNTP::wait4SNTP() 
{
  while (sntp_get_sync_status() != SNTP_SYNC_STATUS_COMPLETED) 
   {
      delay(500);
      Serial.println("ожидание синхронизации ...");
   }
}
// ****************************************************************************
// *    Извлечь и сформировать строку локальной информации о текущей дате и   *
// *           времени в типизированном виде: "2024-12-28 13:29:07"           *
// *                               https://cplusplus.com/reference/ctime/tm/  *
// ****************************************************************************
/*
 "%A, %B %d %Y %H:%M:%S" - это спецификаторы формата,  которые определяют,  как
 в struct tm timeinfo; будет отформатирован текст, а члены tm struct следующие:
  
  Тип элемента Значение                        Диапазон
  -----------------------------------------------------
  tm_sec  int  секунды после минуты            0-61*
  tm_min  int  минуты после часа               0-59
  tm_hour int  часы с полуночи                 0-23
  tm_mday int  день месяца                     1-31
  tm_mon  int  месяцы с января                 0-11
  tm_year int  годы с 1900
  tm_wday  —   количество дней с воскресенья   0-6
  tm_yday  —   количество дней с 1 января      0-365
  tm_isdst —   флаг перехода на летнее время 
  
  function strftime() - format time as string:
  https://cplusplus.com/reference/ctime/strftime/
*/
// ****************************************************************************
// *    Извлечь и сформировать строку локальной информации о текущей дате и   *
// *           времени в типизированном виде: "2024-12-28 13:29:07"           *
// *                               https://cplusplus.com/reference/ctime/tm/  *
// ****************************************************************************
String TAttachSNTP::strTime() 
{
   struct tm timeinfo;
   getLocalTime(&timeinfo);
   sprintf(strftime_buf,"%d-%s-%s %s:%s:%s", 
   timeinfo.tm_year+1900, zfil2(timeinfo.tm_mon+1), zfil2(timeinfo.tm_mday),
   zfil2(timeinfo.tm_hour), zfil2(timeinfo.tm_min), zfil2(timeinfo.tm_sec));
   return String(strftime_buf);
}
// ****************************************************************************
// *           Извлечь и сформировать строку о текущей дате и времени         *
// *                в указанной временной зоне (часовом поясе)                *
// ****************************************************************************
String TAttachSNTP::strLocalTime(const char* value)
{
   setenv("TZ", value, 1);
   tzset();
   localtime_r(&now, &timeinfo);
   String cStr=strTime(); 
   setTimezone();
   return cStr;
}
// ****************************************************************************
// *                 Двузначное число представить в виде строки,              *
// *              в том числе, однозначное число дополнить слева нулем        *
// ****************************************************************************
String TAttachSNTP::zfil2(int n) 
{
   String cRet;
   if (n>9) cRet=String(n);
   else cRet="0"+String(n);
   return cRet;
}
// ****************************************************************************
// *             Узнать подключенный пул серверов точного времени             *
// ****************************************************************************
String TAttachSNTP::getservername()
{
   return String(ServerName);
}
// ****************************************************************************
// *             Узнать установленную временную зону (часовой пояс)           *
// ****************************************************************************
String TAttachSNTP::gettimezone()
{
   return String(Timezone);
}
// ****************************************************************************
// *                 Узнать число минут (интервал) синхронизации              *
// ****************************************************************************
int TAttachSNTP::getsynchromin()
{
   return SynchroMIN;
}

// ********************************************************* AttachSNTP.cpp ***
